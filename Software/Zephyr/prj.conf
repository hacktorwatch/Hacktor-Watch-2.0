## CMakeLists.txt
```
cmake_minimum_required(VERSION 3.20.0)

set(BOARD esp32s3_devkitc/esp32s3/procpu CACHE STRING "Default Zephyr board")

find_package(Zephyr REQUIRED HINTS $ENV{ZEPHYR_BASE})
project(minimal_zephyr_app)

target_sources(app PRIVATE
    src/main.c
    src/panel.c
    src/assets/step_icon.c
)
```

## prj.conf
```kconfig
CONFIG_CONSOLE=y
CONFIG_UART_CONSOLE=y
CONFIG_SERIAL=y
CONFIG_SERIAL_ESP32_USB=y
CONFIG_SHELL=y
CONFIG_SHELL_BACKEND_SERIAL=y
CONFIG_SHELL_PROMPT_UART="hacktor:~$ "
CONFIG_SHELL_STACK_SIZE=4096
CONFIG_GPIO=y
CONFIG_PRINTK=y
CONFIG_SPI=y
CONFIG_INPUT=y
CONFIG_DISPLAY=y
CONFIG_FUEL_GAUGE=y
CONFIG_MAX17048=y
CONFIG_LOG=y
CONFIG_MAIN_STACK_SIZE=4096
CONFIG_LVGL=y
CONFIG_LV_Z_AUTO_INIT=n
CONFIG_LV_Z_MEM_POOL_SIZE=65536
CONFIG_LV_USE_LABEL=y
CONFIG_LV_USE_LINE=y
CONFIG_LV_FONT_MONTSERRAT_14=y
CONFIG_LV_FONT_MONTSERRAT_20=y
CONFIG_LV_FONT_DEFAULT_MONTSERRAT_14=y
CONFIG_LV_COLOR_16_SWAP=y

# Shell tools for poking at the hardware from the console.
CONFIG_DEVICE_SHELL=y
CONFIG_GPIO_SHELL=y
CONFIG_I2C_SHELL=y
CONFIG_KERNEL_SHELL=y
```

## src/main.c
```c
#include "panel.h"

int main(void)
{
	return panel_run();
}
```
